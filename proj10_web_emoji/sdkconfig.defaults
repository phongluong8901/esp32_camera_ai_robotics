## proj_7_camera_AI/sdkconfig.defaults
```kconfig
# PSRAM
CONFIG_ESP32S3_SPIRAM_SUPPORT=y
CONFIG_SPIRAM=y
CONFIG_SPIRAM_MODE_OCT=y
CONFIG_SPIRAM_SPEED_80M=y
CONFIG_SPIRAM_BOOT_INIT=y
CONFIG_SPIRAM_USE_MALLOC=y

# Flash 16MB
CONFIG_ESPTOOLPY_FLASHSIZE_16MB=y

# Camera
CONFIG_OV5640_SUPPORT=y
CONFIG_CAMERA_CORE0=y
CONFIG_CAMERA_DMA_BUFFER_SIZE_MAX=32768

# CPU 240MHz
CONFIG_ESP_DEFAULT_CPU_FREQ_MHZ_240=y
CONFIG_ESP_DEFAULT_CPU_FREQ_MHZ=240

# ESP-DL / AI Stack
CONFIG_ESP_MAIN_TASK_STACK_SIZE=16384

# Model Storage (Nạp trực tiếp vào Flash RODATA để không cần nạp phân vùng riêng)
CONFIG_HUMAN_FACE_DETECT_MODEL_IN_FLASH_RODATA=y
```
